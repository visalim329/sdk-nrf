## samples/bluetooth/throughput/Kconfig
```kconfig
#
# Copyright (c) 2022 Nordic Semiconductor
#
# SPDX-License-Identifier: LicenseRef-Nordic-5-Clause
#

source "Kconfig.zephyr"

menu "Nordic BLE throughput sample"


config BT_THROUGHPUT_FILE
	bool "BT file based throughput"
	default n

config BT_THROUGHPUT_DURATION
	int "Throughput test duration in milliseconds"
	default 20000

config BT_CONN_CENTRAL_TEST_DURATION
	int "test duration in milliseconds"
	default 20000

config INTERVAL_MIN
	int "BLE min connection interval. Each unit 1.25milliseconds"
	default 80

config INTERVAL_MAX
	int "BLE max connection interval. Each unit 1.25milliseconds"
	default 80
	
config BT_GAP_ADV_FAST_INT_MIN_2
	int "BT GAP ADV interval min value. Each unit 0.625milliseconds"
	default 160

config BT_GAP_ADV_FAST_INT_MAX_2
	int "BT GAP ADV interval max value. Each unit 0.625milliseconds"
	default 240

config BT_LE_SCAN_INTERVAL
	int "BT LE Scan interval  value. Each unit is 0.625milliseconds."
	default 16

config BT_LE_SCAN_WINDOW
	int "BT LE Scan Window value. Each unit is 0.625milliseconds."
	default 16

config BT_SUPERVISION_TIMEOUT
	int "BT LE supervision timeout"
	default 1000

config BT_CONN_LATENCY
	int "BT LE connection latency"
	default 0
	
choice BT_TEST_TYPE
	prompt "Test type"
	default BLE_CONN_CENTRAL_TEST

config BLE_THROUGHPUT_TEST
	bool "BT LE throughput test"
	help
	  Enable BT LE throughput test only

config BLE_CONN_CENTRAL_TEST
	bool "BT LE connection test"
	help
	  Enable BT LE connection test only
endchoice


endmenu
```

## samples/wifi/sr_coex/test/Kconfig
```kconfig
#
# Copyright (c) 2023 Nordic Semiconductor
#
# SPDX-License-Identifier: LicenseRef-Nordic-5-Clause
#

menu "Nordic Coex sample - test"

#----------------------------------- system tests
config WIFI_SCAN_BLE_CON_CENTRAL
	bool "Indicates test is to be run or not"
	default n

config WIFI_SCAN_BLE_CON_PERIPH
	bool "Indicates test is to be run or not"
	default n

config WIFI_SCAN_BLE_TP_CENTRAL
	bool "Indicates test is to be run or not"
	default n

config WIFI_SCAN_BLE_TP_PERIPH
	bool "Indicates test is to be run or not"
	default n

config WIFI_CON_SCAN_BLE_CON_CENTRAL
	bool "Indicates test is to be run or not"
	default n

config WIFI_CON_SCAN_BLE_CON_PERIPH
	bool "Indicates test is to be run or not"
	default n

config WIFI_CON_SCAN_BLE_TP_CENTRAL
	bool "Indicates test is to be run or not"
	default n

config WIFI_CON_SCAN_BLE_TP_PERIPH
	bool "Indicates test is to be run or not"
	default n

config WIFI_CON_BLE_CON_CENTRAL
	bool "Indicates test is to be run or not"
	default n

config WIFI_CON_BLE_CON_PERIPH
	bool "Indicates test is to be run or not"
	default n

config WIFI_CON_BLE_TP_CENTRAL
	bool "Indicates test is to be run or not"
	default n

config WIFI_CON_BLE_TP_PERIPH
	bool "Indicates test is to be run or not"
	default n

config WIFI_TP_UDP_CLIENT_BLE_CON_CENTRAL
	bool "Indicates test is to be run or not"
	default n

config WIFI_TP_UDP_CLIENT_BLE_CON_PERIPH
	bool "Indicates test is to be run or not"
	default n

config WIFI_TP_UDP_CLIENT_BLE_TP_CENTRAL
	bool "Indicates test is to be run or not"
	default n

config WIFI_TP_UDP_CLIENT_BLE_TP_PERIPH
	bool "Indicates test is to be run or not"
	default n

config WIFI_TP_UDP_SERVER_BLE_CON_CENTRAL
	bool "Indicates test is to be run or not"
	default n

config WIFI_TP_UDP_SERVER_BLE_CON_PERIPH
	bool "Indicates test is to be run or not"
	default n

config WIFI_TP_UDP_SERVER_BLE_TP_CENTRAL
	bool "Indicates test is to be run or not"
	default n

config WIFI_TP_UDP_SERVER_BLE_TP_PERIPH
	bool "Indicates test is to be run or not"
	default n

config WIFI_TP_TCP_CLIENT_BLE_CON_CENTRAL
	bool "Indicates test is to be run or not"
	default n

config WIFI_TP_TCP_CLIENT_BLE_CON_PERIPH
	bool "Indicates test is to be run or not"
	default n

config WIFI_TP_TCP_CLIENT_BLE_TP_CENTRAL
	bool "Indicates test is to be run or not"
	default n

config WIFI_TP_TCP_CLIENT_BLE_TP_PERIPH
	bool "Indicates test is to be run or not"
	default n

config WIFI_TP_TCP_SERVER_BLE_CON_CENTRAL
	bool "Indicates test is to be run or not"
	default n

config WIFI_TP_TCP_SERVER_BLE_CON_PERIPH
	bool "Indicates test is to be run or not"
	default n

config WIFI_TP_TCP_SERVER_BLE_TP_CENTRAL
	bool "Indicates test is to be run or not"
	default n

config WIFI_TP_TCP_SERVER_BLE_TP_PERIPH
	bool "Indicates test is to be run or not"
	default n
#----------------------------------- stability tests
config WIFI_CON_BLE_CON_CENTRAL_STABILITY
	bool "Indicates test is to be run or not"
	default n

config WIFI_CON_BLE_CON_PERIPH_STABILITY
	bool "Indicates test is to be run or not"
	default n

config WIFI_CON_BLE_TP_CENTRAL_STABILITY
	bool "Indicates test is to be run or not"
	default n

config WIFI_CON_BLE_TP_PERIPH_STABILITY
	bool "Indicates test is to be run or not"
	default n
#-----------
config BLE_CONN_CENTRAL_WIFI_SCAN_STABILITY
	bool "Indicates test is to be run or not"
	default n
config BLE_CONN_CENTRAL_WIFI_CON_SCAN_STABILITY
	bool "Indicates test is to be run or not"
	default n
config BLE_CONN_CENTRAL_WIFI_CON_STABILITY
	bool "Indicates test is to be run or not"
	default n
config BLE_CONN_CENTRAL_WIFI_PING_STABILITY
	bool "Indicates test is to be run or not"
	default n
config BLE_CONN_CENTRAL_WIFI_TP_UDP_CLIENT_STABILITY
	bool "Indicates test is to be run or not"
	default n
config BLE_CONN_CENTRAL_WIFI_TP_UDP_SERVER_STABILITY
	bool "Indicates test is to be run or not"
	default n
config BLE_CONN_CENTRAL_WIFI_TP_TCP_CLIENT_STABILITY
	bool "Indicates test is to be run or not"
	default n
config BLE_CONN_CENTRAL_WIFI_TP_TCP_SERVER_STABILITY
	bool "Indicates test is to be run or not"
	default n
#-----------
config BLE_CONN_PERIPHERAL_WIFI_SCAN_STABILITY
	bool "Indicates test is to be run or not"
	default n
config BLE_CONN_PERIPHERAL_WIFI_CON_SCAN_STABILITY
	bool "Indicates test is to be run or not"
	default n
config BLE_CONN_PERIPHERAL_WIFI_CON_STABILITY
	bool "Indicates test is to be run or not"
	default n
config BLE_CONN_PERIPHERAL_WIFI_PING_STABILITY
	bool "Indicates test is to be run or not"
	default n
config BLE_CONN_PERIPHERAL_WIFI_TP_UDP_CLIENT_STABILITY
	bool "Indicates test is to be run or not"
	default n
config BLE_CONN_PERIPHERAL_WIFI_TP_UDP_SERVER_STABILITY
	bool "Indicates test is to be run or not"
	default n
config BLE_CONN_PERIPHERAL_WIFI_TP_TCP_CLIENT_STABILITY
	bool "Indicates test is to be run or not"
	default n
config BLE_CONN_PERIPHERAL_WIFI_TP_TCP_SERVER_STABILITY
	bool "Indicates test is to be run or not"
	default n
#----------------------------------- Wi-Fi shutdown tests
config BLE_CON_CENTRAL_WIFI_SHUTDOWN
	bool "Indicates test is to be run or not"
	default n
config BLE_CON_PERIPHERAL_WIFI_SHUTDOWN
	bool "Indicates test is to be run or not"
	default n
config BLE_TP_CENTRAL_WIFI_SHUTDOWN
	bool "Indicates test is to be run or not"
	default n
config BLE_TP_PERIPH_WIFI_SHUTDOWN
	bool "Indicates test is to be run or not"
	default n

config RUN_SPT_TESTS
	bool "Indicates test is to be run or not"
	default n
config RUN_ST_TESTS
	bool "Indicates test is to be run or not"
	default n
config RUN_WST_TESTS
	bool "Indicates test is to be run or not"
	default n

endmenu
```
