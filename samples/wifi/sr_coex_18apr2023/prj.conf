## CMakeLists.txt
```
#
# Copyright (c) 2022 Nordic Semiconductor ASA
#
# SPDX-License-Identifier: LicenseRef-Nordic-5-Clause
#

cmake_minimum_required(VERSION 3.20.0)

set(DTC_OVERLAY_FILE "dts.overlay")

find_package(Zephyr REQUIRED HINTS $ENV{ZEPHYR_BASE})
project(nrf_wifi_ble_coex)

target_sources(app PRIVATE
	src/bt_cmds.c
	src/bt_utils.c
	src/bt_coex_test_functions.c
	src/main.c
)

# For net_private.h
target_include_directories(app PUBLIC
	${ZEPHYR_BASE}/subsys/net/ip
)

zephyr_library_include_directories(${ZEPHYR_BASE}/samples/bluetooth)
```

## Kconfig
```
#
# Copyright (c) 2022 Nordic Semiconductor
#
# SPDX-License-Identifier: LicenseRef-Nordic-5-Clause
#

source "Kconfig.zephyr"

menu "Nordic Coex sample"

choice TEST_TYPE
	prompt "Test type"
	default TEST_TYPE_WLAN_BLE

config TEST_TYPE_WLAN_ONLY
	bool "WLAN only"
	help
	  Enable WLAN only

config TEST_TYPE_BLE_ONLY
	bool "BLE only"
	help
	  Enable BLE only

config TEST_TYPE_WLAN_BLE
	bool "WLAN and BLE"
	help
	  Enable WLAN and BLE

endchoice

config TEST_TYPE_WLAN
	bool "WLAN"
	default y if TEST_TYPE_WLAN_ONLY || TEST_TYPE_WLAN_BLE
	select WIFI
	help
	  Enable WLAN

config TEST_TYPE_BLE
	bool "BLE"
	default y if TEST_TYPE_BLE_ONLY || TEST_TYPE_WLAN_BLE
	help
	  Enable BLE

config STA_SSID
	string "SSID"
	default "wifi_sr_coex_24"
	help
	  Specify the SSID to connect

choice  STA_KEY_MGMT_SELECT
	prompt "Security Option"
	default STA_KEY_MGMT_NONE

config STA_KEY_MGMT_NONE
	bool "Open Security"
	help
	  Enable for Open Security

config STA_KEY_MGMT_WPA2
	bool "WPA2 Security"
	help
	  Enable for WPA2 Security

config STA_KEY_MGMT_WPA2_256
	bool "WPA2 SHA 256 Security"
	help
	  Enable for WPA2-PSK-256 Security

config STA_KEY_MGMT_WPA3
	bool "WPA3 Security"
	help
	  Enable for WPA3 Security
endchoice

config STA_PASSWORD
	string "Passphrase (WPA2) or password (WPA3)"
	help
	  Specify the Password to connect

config NET_CONFIG_PEER_IPV4_ADDR
	string "Peer IPv4 address"
	default "192.168.1.253"

config NET_CONFIG_PEER_IPV4_PORT
	int "Peer IPv4 port"
	default 5001

config WIFI_THREAD_STACK_SIZE
	int "Wi-Fi thread stack size"
	default 4096

config WIFI_THREAD_PRIORITY
	int "Wi-Fi thread priority"
	default 5

config WIFI_ZPERF_SERVER
	bool "Zperf role: server or client"
	default n

config WIFI_ZPERF_PROT_UDP
	bool "UDP or TCP"
	default y

config WIFI_ZPERF_PKT_SIZE
	int "packet size"
	default 1024

config WIFI_ZPERF_RATE
	int "rate in kbps"
	default 10000

config INTERVAL_MIN
	int "BLE min connection interval. Each unit 1.25milliseconds"
	default 80

config INTERVAL_MAX
	int "BLE max connection interval. Each unit 1.25milliseconds"
	default 80

config COEX_ENABLE
	bool "Control if coexistence HW is enable"
	default y

config COEX_WLAN_2PT4G
	bool "Indicates if WLAN operating band is 2.4GHz or 5GHz"
	default y

config WIFI_TEST_DURATION
	int "test duration in milliseconds"
	default 10000

config BLE_TEST_DURATION
	int "test duration in milliseconds"
	default 10000

config COEX_BT_CENTRAL
	bool "BT device role"
	default y

config COEX_SEP_ANTENNAS
	bool "Control if the antennas are shared/serparate for BT and WLAN"
	default y

config WIFI_COEX_ENABLE
	bool "Indicates if Wi-Fi posts requests to PTA"
	default y

config RPU_ENABLE
	bool "Indicates if PRU is enable"
	default y

config BT_GAP_ADV_FAST_INT_MIN_2
	int "BT GAP ADV interval min value. Each unit 0.625milliseconds"
	default 160

config BT_GAP_ADV_FAST_INT_MAX_2
	int "BT GAP ADV interval max value. Each unit 0.625milliseconds"
	default 240

config BT_LE_SCAN_INTERVAL
	int "BT LE Scan interval  value. Each unit is 0.625milliseconds."
	default 16

config BT_LE_SCAN_WINDOW
	int "BT LE Scan Window value. Each unit is 0.625milliseconds."
	default 16

config COEX_HARDWARE_ENABLE
	bool "Indicates if COEX hardware module enabled"
	default y

endmenu
```

## prj.conf
```kconfig
#
# Copyright (c) 2022 Nordic Semiconductor ASA
#
# SPDX-License-Identifier: LicenseRef-Nordic-5-Clause
#
CONFIG_WIFI=y
CONFIG_WIFI_NRF700X=y

# WPA supplicant
CONFIG_WPA_SUPP=y

# System settings
CONFIG_NEWLIB_LIBC=y
CONFIG_NEWLIB_LIBC_NANO=n

# Networking
CONFIG_NETWORKING=y
CONFIG_NET_SOCKETS=y
CONFIG_POSIX_API=y
CONFIG_NET_LOG=y
CONFIG_NET_IPV4=y
CONFIG_NET_UDP=y
CONFIG_NET_TCP=y
CONFIG_NET_DHCPV4=y


CONFIG_NET_IF_UNICAST_IPV4_ADDR_COUNT=2
CONFIG_NET_MAX_CONTEXTS=8
CONFIG_NET_CONTEXT_SYNC_RECV=y

CONFIG_INIT_STACKS=y

CONFIG_NET_L2_ETHERNET=y

CONFIG_NET_CONFIG_SETTINGS=y

CONFIG_NET_SOCKETS_POLL_MAX=4

# Memories
CONFIG_MAIN_STACK_SIZE=4096
CONFIG_SYSTEM_WORKQUEUE_STACK_SIZE=2048
CONFIG_NET_TX_STACK_SIZE=4096
CONFIG_NET_RX_STACK_SIZE=4096

# Debugging
CONFIG_STACK_SENTINEL=y
CONFIG_DEBUG_COREDUMP=y
CONFIG_DEBUG_COREDUMP_BACKEND_LOGGING=y
CONFIG_DEBUG_COREDUMP_MEMORY_DUMP_MIN=y

# Kernel options
CONFIG_ENTROPY_GENERATOR=y

# Logging
CONFIG_LOG=y
CONFIG_PRINTK=y
CONFIG_POSIX_CLOCK=y

# Benchmarking
CONFIG_NET_ZPERF=y

# Optimized networking settings for performance
CONFIG_NET_TC_TX_COUNT=1
CONFIG_NET_PKT_RX_COUNT=2
CONFIG_NET_PKT_TX_COUNT=24
CONFIG_NET_BUF_RX_COUNT=2
CONFIG_NET_BUF_TX_COUNT=48
CONFIG_HEAP_MEM_POOL_SIZE=200000
CONFIG_NET_BUF_DATA_SIZE=1100

# Below configs need to be modified based on security
CONFIG_STA_KEY_MGMT_NONE=y
# CONFIG_STA_KEY_MGMT_WPA2=y
# CONFIG_STA_KEY_MGMT_WPA2_256=y
# CONFIG_STA_KEY_MGMT_WPA3=y
CONFIG_STA_SSID="wifi_sr_coex_24"
CONFIG_STA_PASSWORD="Mypassword"

CONFIG_NET_CONFIG_MY_IPV4_ADDR="192.168.1.99"
CONFIG_NET_CONFIG_MY_IPV4_NETMASK="255.255.255.0"
CONFIG_NET_CONFIG_MY_IPV4_GW="192.168.1.1"

# DUT zperf configuration
CONFIG_WIFI_ZPERF_PROT_UDP=y
CONFIG_WIFI_ZPERF_PKT_SIZE=1024
CONFIG_WIFI_ZPERF_RATE=15000
CONFIG_WIFI_ZPERF_SERVER=n

CONFIG_BT_DEVICE_NAME="Nordic_coex_dut"
CONFIG_BT=y
CONFIG_BT_DEBUG_LOG=y
CONFIG_BT_SMP=y
CONFIG_BT_PERIPHERAL=y
CONFIG_BT_CENTRAL=y
CONFIG_BT_MAX_CONN=2

CONFIG_BT_SCAN=y
CONFIG_BT_SCAN_FILTER_ENABLE=y
CONFIG_BT_SCAN_UUID_CNT=1

CONFIG_BT_GATT_CLIENT=y
CONFIG_BT_GATT_DM=y
CONFIG_BT_THROUGHPUT=y

CONFIG_BT_USER_DATA_LEN_UPDATE=y
CONFIG_BT_USER_PHY_UPDATE=y
CONFIG_BT_GAP_AUTO_UPDATE_CONN_PARAMS=n

CONFIG_BT_BUF_ACL_RX_SIZE=502
CONFIG_BT_ATT_PREPARE_COUNT=2
CONFIG_BT_CONN_TX_MAX=10
CONFIG_BT_L2CAP_TX_BUF_COUNT=10
CONFIG_BT_L2CAP_TX_MTU=498
CONFIG_BT_BUF_ACL_TX_SIZE=502
CONFIG_BT_L2CAP_DYNAMIC_CHANNEL=y

CONFIG_DK_LIBRARY=y
CONFIG_DK_LIBRARY_DYNAMIC_BUTTON_HANDLERS=y
CONFIG_NRF700X_MAX_TX_PENDING_QLEN=12
```

## prj_nrf5340dk_nrf5340_cpuapp.conf
```kconfig
#
# Copyright (c) 2022 Nordic Semiconductor ASA
#
# SPDX-License-Identifier: LicenseRef-Nordic-5-Clause
#
CONFIG_SHELL=y

CONFIG_BT_DEVICE_NAME="Nordic_coex_peer"
CONFIG_BT=y
CONFIG_BT_DEBUG_LOG=y
CONFIG_BT_SMP=y
CONFIG_BT_PERIPHERAL=y
CONFIG_BT_CENTRAL=y
CONFIG_BT_MAX_CONN=2

CONFIG_BT_SCAN=y
CONFIG_BT_SCAN_FILTER_ENABLE=y
CONFIG_BT_SCAN_UUID_CNT=1

CONFIG_BT_GATT_CLIENT=y
CONFIG_BT_GATT_DM=y
CONFIG_BT_THROUGHPUT=y

CONFIG_HEAP_MEM_POOL_SIZE=2048

CONFIG_BT_USER_DATA_LEN_UPDATE=y
CONFIG_BT_USER_PHY_UPDATE=y
CONFIG_BT_GAP_AUTO_UPDATE_CONN_PARAMS=n

CONFIG_BT_BUF_ACL_RX_SIZE=502
CONFIG_BT_ATT_PREPARE_COUNT=2
CONFIG_BT_CONN_TX_MAX=10
CONFIG_BT_L2CAP_TX_BUF_COUNT=10
CONFIG_BT_L2CAP_TX_MTU=498
CONFIG_BT_BUF_ACL_TX_SIZE=502
CONFIG_BT_L2CAP_DYNAMIC_CHANNEL=y

CONFIG_DK_LIBRARY=y
CONFIG_DK_LIBRARY_DYNAMIC_BUTTON_HANDLERS=y
```

## src/main.c
```c
/**
 * Copyright (c) 2022 Nordic Semiconductor ASA
 *
 * SPDX-License-Identifier: LicenseRef-Nordic-5-Clause
 */

/** @file
 * @brief SR coexistence sample test bench
 */

#include <stdio.h>
#include <stdlib.h>
#include <string.h>
#include <stdbool.h>

//#include "common.h"
#include "main.h"

#include <nrfx_clock.h>

#if !defined(BLE_PEER_THROUGHPUT_TEST) && !defined(BLE_PEER_CONN_CENTRAL_TEST)
#include "zephyr_fmac_main.h"
#endif

#include <zephyr/logging/log.h>
LOG_MODULE_REGISTER(main, CONFIG_LOG_DEFAULT_LEVEL);

#if !defined(BLE_PEER_THROUGHPUT_TEST) && !defined(BLE_PEER_CONN_CENTRAL_TEST)
void print_test_params_info(bool test_wlan, bool test_ble,
				bool antenna_mode, bool ble_role, bool wifi_coex_enable,
				bool ble_coex_enable, bool coex_hardware_enable)
{
	if (test_wlan && test_ble) {
		if (coex_hardware_enable) {
			LOG_INF("Running WLAN and BLE tests with coex hardware enable");
		} else {
			LOG_INF("Running WLAN and BLE tests with coex hardware disable");
		}
	} else {
		if (test_wlan) {
			LOG_INF("Running WLAN only test");
		} else {
			LOG_INF("Running BLE only test");
		}
	}
	if (antenna_mode) {
		LOG_INF("Antenna mode : Separate antennas");
	} else {
		LOG_INF("Antenna mode : Shared antennas");
	}

	if (ble_role) {
		LOG_INF("BLE role : Central");
	} else {
		LOG_INF("BLE role : Peripheral");
	}

	if (wifi_coex_enable) {
		LOG_INF("WLAN posts requests to PTA");
	} else {
		LOG_INF("WLAN doesn't post requests to PTA");
	}

	if (ble_coex_enable) {
		LOG_INF("BLE posts requests to PTA");
	} else {
		LOG_INF("BLE doesn't post requests to PTA");
	}
	if (IS_ENABLED(CONFIG_RPU_ENABLE)) {
		LOG_INF("RPU enabled");
	} else {
		LOG_INF("RPU disabled");
	}
}


void net_mgmt_event_handler(struct net_mgmt_event_callback *cb,
				    uint32_t mgmt_event, struct net_if *iface)
{
	switch (mgmt_event) {
	case NET_EVENT_IPV4_DHCP_BOUND:
		print_dhcp_ip(cb);
		break;
	default:
		break;
	}
}

void wifi_mgmt_event_handler(struct net_mgmt_event_callback *cb,
				uint32_t mgmt_event, struct net_if *iface)
{
	const struct device *dev = iface->if_dev->dev;
	struct wifi_nrf_vif_ctx_zep *vif_ctx_zep = NULL;

	vif_ctx_zep = dev->data;

	switch (mgmt_event) {
	case NET_EVENT_WIFI_CONNECT_RESULT:
		handle_wifi_connect_result(cb);
		break;
	case NET_EVENT_WIFI_DISCONNECT_RESULT:
		handle_wifi_disconnect_result(cb);
		break;
	case NET_EVENT_WIFI_SCAN_RESULT:
		vif_ctx_zep->scan_in_progress = 0;
		handle_wifi_scan_result(cb);
		break;
	case NET_EVENT_WIFI_SCAN_DONE:
		handle_wifi_scan_done(cb);
		break;
	default:
		break;
	}
}
#endif

int main(void)
{

#if defined(BLE_PEER_THROUGHPUT_TEST) || defined(BLE_PEER_CONN_CENTRAL_TEST)
	#ifdef BLE_PEER_THROUGHPUT_TEST
		LOG_INF("BLE peer throughput test");
	#else
		LOG_INF("BLE peer connection-central test");
	#endif
	ble_peer_tp_conn();
#endif 

#if !defined(BLE_PEER_THROUGHPUT_TEST) && !defined(BLE_PEER_CONN_CENTRAL_TEST)

		int ret = 0;
	bool wifi_coex_enable = IS_ENABLED(CONFIG_WIFI_COEX_ENABLE);
	bool ble_coex_enable = IS_ENABLED(CONFIG_MPSL_CX);
	bool coex_hardware_enable = IS_ENABLED(CONFIG_COEX_HARDWARE_ENABLE);
	bool antenna_mode = IS_ENABLED(CONFIG_COEX_SEP_ANTENNAS);
	bool ble_role = IS_ENABLED(CONFIG_COEX_BT_CENTRAL);
	bool wlan_role = IS_ENABLED(CONFIG_WIFI_ZPERF_SERVER);

		bool test_wlan = IS_ENABLED(CONFIG_TEST_TYPE_WLAN);
		bool test_ble = IS_ENABLED(CONFIG_TEST_TYPE_BLE);

	#if !defined(CONFIG_BOARD_NRF7002DK_NRF5340_CPUAPP) && !defined(CONFIG_COEX_SEP_ANTENNAS)
		BUILD_ASSERT("Shared antenna support is not available with nRF7002 shields");
	#endif

		memset_context();

		net_mgmt_init_event_callback(&wifi_sta_mgmt_cb,
					wifi_mgmt_event_handler,
					WIFI_MGMT_EVENTS);

		net_mgmt_add_event_callback(&wifi_sta_mgmt_cb);

		net_mgmt_init_event_callback(&net_addr_mgmt_cb,
					net_mgmt_event_handler,
					NET_EVENT_IPV4_DHCP_BOUND);

		net_mgmt_add_event_callback(&net_addr_mgmt_cb);

	#ifdef CLOCK_FEATURE_HFCLK_DIVIDE_PRESENT
		nrfx_clock_divider_set(NRF_CLOCK_DOMAIN_HFCLK, NRF_CLOCK_HFCLK_DIV_1);
	#endif

		LOG_INF("Starting %s with CPU frequency: %d MHz", CONFIG_BOARD,
					SystemCoreClock/MHZ(1));
		k_sleep(K_SECONDS(1));

		print_test_params_info(test_wlan, test_ble, antenna_mode, ble_role,
					wifi_coex_enable, ble_coex_enable, coex_hardware_enable);

	#ifdef CONFIG_NRF700X_BT_COEX
		/* Configure SR side (nRF5340 side) switch in nRF7002 DK */
		LOG_INF("Configure SR side (nRF5340 side) switch");
		ret = nrf_wifi_config_sr_switch(antenna_mode);
		if (ret != 0) {
			LOG_ERR("Unable to configure SR side switch: %d", ret);
			goto err;
		}

		/* Configure Coexistence Hardware non-PTA registers */
		LOG_INF("Configuring non-PTA registers.");
		ret = nrf_wifi_coex_config_non_pta(antenna_mode);
		if (ret != 0) {
			LOG_ERR("Configuring non-PTA registers of CoexHardware FAIL");
			goto err;
		}
	#endif /* CONFIG_NRF700X_BT_COEX */

		/**if (!(IS_ENABLED(CONFIG_RPU_ENABLE))) {
		 *	LOG_INF("RPU disabled");
		 *	rpu_disable();
		 *}
		 */

		#ifdef WIFI_SCAN_BLE_CON_CENTRAL
			LOG_INF("Test case: wifi_scan_ble_conn_central");
			ret = wifi_scan_ble_conn_central(wifi_coex_enable, antenna_mode, test_ble,
					test_wlan, ble_role, wlan_role, coex_hardware_enable);
			if (ret != 0) {
				LOG_ERR("Running wifi_scan_ble_conn_central fail");
				goto err;
			}
		#endif

		#ifdef WIFI_SCAN_BLE_CON_PERIPH
			LOG_INF("Test case: wifi_scan_ble_conn_peripheral");
			ret = wifi_scan_ble_conn_peripheral(wifi_coex_enable, antenna_mode, test_ble,
					test_wlan, ble_role, wlan_role, coex_hardware_enable);
			if (ret != 0) {
				LOG_ERR("Running wifi_scan_ble_conn_peripheral fail");
				goto err;
			}
		#endif

		#ifdef WIFI_SCAN_BLE_TP_CENTRAL
			LOG_INF("Test case: wifi_scan_ble_tput_central");
			ret = wifi_scan_ble_tput_central(wifi_coex_enable, antenna_mode,
					test_ble, test_wlan, ble_role, wlan_role, coex_hardware_enable);
			if (ret != 0) {
				LOG_ERR("Running wifi_scan_ble_tput_central fail");
				goto err;
			}
		#endif

		#ifdef WIFI_SCAN_BLE_TP_PERIPH
			LOG_INF("Test case: wifi_scan_ble_tput_peripheral");
			ret = wifi_scan_ble_tput_peripheral(wifi_coex_enable, antenna_mode,
					test_ble, test_wlan, ble_role, wlan_role, coex_hardware_enable);
			if (ret != 0) {
				LOG_ERR("Running wifi_scan_ble_tput_peripheral fail");
				goto err;
			}
		#endif

		#ifdef WIFI_CON_BLE_CON_CENTRAL
			LOG_INF("Test case: wifi_con_ble_con_central");
			ret = wifi_con_ble_con_central(test_wlan, wifi_coex_enable, test_ble, ble_role,
					wlan_role, antenna_mode, coex_hardware_enable);
			if (ret != 0) {
				LOG_ERR("Running wifi_con_ble_con_central fail");
				goto err;
			}
		#endif

		#ifdef WIFI_CON_BLE_CON_PERIPH
			LOG_INF("Test case: wifi_con_ble_con_peripheral");
			ret = wifi_con_ble_con_peripheral(test_wlan, wifi_coex_enable, test_ble,
					ble_role, wlan_role, antenna_mode, coex_hardware_enable);
			if (ret != 0) {
				LOG_ERR("Running wifi_con_ble_con_peripheral fail");
				goto err;
			}
		#endif

		#ifdef WIFI_CON_BLE_TP_CENTRAL
			LOG_INF("Test case: wifi_con_ble_tput_central");
			ret = wifi_con_ble_tput_central(test_wlan, wifi_coex_enable, antenna_mode,
					test_ble, ble_role, wlan_role, coex_hardware_enable);
			if (ret != 0) {
				LOG_ERR("Running wifi_con_ble_tput_central fail");
				goto err;
			}
		#endif

		#ifdef WIFI_CON_BLE_TP_PERIPH
			LOG_INF("Test case: wifi_con_ble_tput_peripheral");
			ret = wifi_con_ble_tput_peripheral(test_wlan, wifi_coex_enable, antenna_mode,
					test_ble, ble_role, wlan_role, coex_hardware_enable);
			if (ret != 0) {
				LOG_ERR("Running wifi_con_ble_tput_peripheral fail");
				goto err;
			}
		#endif

		#ifdef WIFI_TP_CLIENT_BLE_CON_CENTRAL
			LOG_INF("Test case: wifi_tput_client_ble_con_central");
			ret = wifi_tput_client_ble_con_central(test_wlan, wifi_coex_enable, test_ble,
					ble_role, wlan_role, antenna_mode, coex_hardware_enable);
			if (ret != 0) {
				LOG_ERR("Running wifi_tput_client_ble_con_central fail");
				goto err;
			}
		#endif

		#ifdef WIFI_TP_CLIENT_BLE_CON_PERIPH
			LOG_INF("Test case: wifi_tput_client_ble_con_peripheral");
			ret = wifi_tput_client_ble_con_peripheral(test_wlan, wifi_coex_enable, test_ble,
					ble_role, wlan_role, antenna_mode, coex_hardware_enable);
			if (ret != 0) {
				LOG_ERR("Running wifi_tput_client_ble_con_peripheral fail");
				goto err;
			}
		#endif

		#ifdef WIFI_TP_SERVER_BLE_CON_CENTRAL
			LOG_INF("Test case: wifi_tput_server_ble_con_central");
			ret = wifi_tput_server_ble_con_central(test_wlan, wifi_coex_enable, test_ble,
					ble_role, wlan_role, antenna_mode, coex_hardware_enable);
			if (ret != 0) {
				LOG_ERR("Running wifi_tput_server_ble_con_central fail");
				goto err;
			}
		#endif

		#ifdef WIFI_TP_SERVER_BLE_CON_PERIPH
			LOG_INF("Test case: wifi_tput_server_ble_con_peripheral");
			ret = wifi_tput_server_ble_con_peripheral(test_wlan, wifi_coex_enable, test_ble,
					ble_role,
					wlan_role, antenna_mode, coex_hardware_enable);
			if (ret != 0) {
				LOG_ERR("Running wifi_tput_server_ble_con_peripheral fail");
				goto err;
			}
		#endif

		#ifdef WIFI_TP_CLIENT_BLE_TP_CENTRAL
			if (!IS_ENABLED(CONFIG_WIFI_ZPERF_SERVER) && IS_ENABLED(CONFIG_COEX_BT_CENTRAL)) {
				LOG_INF(" Test case: wifi_tput_client_ble_tput_central");
				ret = wifi_tput_client_ble_tput_central(test_wlan, wifi_coex_enable,
						antenna_mode, test_ble, ble_role,
				wlan_role, coex_hardware_enable);
				if (ret != 0) {
					LOG_ERR("Running wifi_tput_client_ble_tput_central fail");
					goto err;
				}
			}
		#endif

		#ifdef WIFI_TP_CLIENT_BLE_TP_PERIPH
			if (!IS_ENABLED(CONFIG_WIFI_ZPERF_SERVER) && !IS_ENABLED(CONFIG_COEX_BT_CENTRAL)) {
				LOG_INF(" Test case: wifi_tput_client_ble_tput_peripheral");
				ret = wifi_tput_client_ble_tput_peripheral(test_wlan, wifi_coex_enable,
				antenna_mode, test_ble, ble_role, wlan_role, coex_hardware_enable);
				if (ret != 0) {
					LOG_ERR("Running wifi_tput_client_ble_tput_peripheral fail");
					goto err;
				}
			}
		#endif

		#ifdef WIFI_TP_SERVER_BLE_TP_CENTRAL
			if (IS_ENABLED(CONFIG_WIFI_ZPERF_SERVER) && IS_ENABLED(CONFIG_COEX_BT_CENTRAL)) {
				LOG_INF(" Test case: wifi_tput_server_ble_tput_central");
				ret = wifi_tput_server_ble_tput_central(test_wlan, wifi_coex_enable,
					antenna_mode, test_ble, ble_role, wlan_role, coex_hardware_enable);
				if (ret != 0) {
					LOG_ERR("Running wifi_tput_server_ble_tput_central fail");
					goto err;
				}
			}
		#endif

		#ifdef WIFI_TP_SERVER_BLE_TP_PERIPH
			if (IS_ENABLED(CONFIG_WIFI_ZPERF_SERVER) && !IS_ENABLED(CONFIG_COEX_BT_CENTRAL)) {
				LOG_INF(" Test case: wifi_tput_server_ble_tput_peripheral");
				ret = wifi_tput_server_ble_tput_peripheral(test_wlan, wifi_coex_enable,
						antenna_mode, test_ble, ble_role, wlan_role,
						coex_hardware_enable);
				if (ret != 0) {
					LOG_ERR("Running wifi_tput_server_ble_tput_peripheral fail");
					goto err;
				}
			}
		#endif

		return 0;

	err:
		LOG_INF("Returning with error");
		return ret;
#endif
}
```

## src/bt_cmds.c
```c
/*
 * Copyright (c) 2020 Nordic Semiconductor ASA
 *
 * SPDX-License-Identifier: LicenseRef-Nordic-5-Clause
 */

#include <stdlib.h>

#include <zephyr/bluetooth/conn.h>

#include <errno.h>
#include <zephyr/shell/shell.h>
#include <zephyr/types.h>

#include "main.h"

#define INTERVAL_MIN 80 /* 80 units, 100 ms */
#define INTERVAL_MAX 80 /* 80 units, 100 ms */
#define CONN_LATENCY 0

#define MIN_CONN_INTERVAL   6
#define MAX_CONN_INTERVAL   3200
#define SUPERVISION_TIMEOUT 1000

#if defined(BLE_PEER_THROUGHPUT_TEST) || defined(BLE_PEER_CONN_CENTRAL_TEST)
static struct test_params {
	struct bt_le_conn_param *conn_param;
	struct bt_conn_le_phy_param *phy;
	struct bt_conn_le_data_len_param *data_len;
} test_params = {
	.conn_param = BT_LE_CONN_PARAM(INTERVAL_MIN, INTERVAL_MAX, CONN_LATENCY,
				       SUPERVISION_TIMEOUT),
	.phy = BT_CONN_LE_PHY_PARAM_2M,
	.data_len = BT_LE_DATA_LEN_PARAM_MAX
};

static const char *phy_str(const struct bt_conn_le_phy_param *phy)
{
	static const char *const str[] = {
		"1 Mbps",
		"2 Mbps",
		"Coded S2",
		"Coded S8",
		"Unknown"
	};

	switch (phy->pref_tx_phy) {
	case BT_GAP_LE_PHY_1M:
		return str[0];

	case BT_GAP_LE_PHY_2M:
		return str[1];

	case BT_GAP_LE_PHY_CODED:
		if (phy->options == BT_CONN_LE_PHY_OPT_CODED_S2) {
			return str[2];
		} else if (phy->options == BT_CONN_LE_PHY_OPT_CODED_S8) {
			return str[3];
		}

	default:
		return str[4];
	}
}

int default_cmd(const struct shell *shell, size_t argc,
		       char **argv)
{
	if (argc == 1) {
		shell_help(shell);
		return SHELL_CMD_HELP_PRINTED;
	}

	if (argc > 2) {
		shell_error(shell, "%s: bad parameters count.", argv[0]);
		return -EINVAL;
	}

	if (argc == 2) {
		shell_error(shell, "Uknown argument: %s", argv[1]);
		return -EINVAL;
	}

	return 0;
}

int cmd_phy_1m(const struct shell *shell, size_t argc,
		      char **argv)
{
	test_params.phy->options = BT_CONN_LE_PHY_OPT_NONE;
	test_params.phy->pref_rx_phy = BT_GAP_LE_PHY_1M;
	test_params.phy->pref_tx_phy = BT_GAP_LE_PHY_1M;

	shell_print(shell, "PHY set to: %s", phy_str(test_params.phy));

	return 0;
}

int cmd_phy_2m(const struct shell *shell, size_t argc,
		      char **argv)
{
	test_params.phy->options = BT_CONN_LE_PHY_OPT_NONE;
	test_params.phy->pref_rx_phy = BT_GAP_LE_PHY_2M;
	test_params.phy->pref_tx_phy = BT_GAP_LE_PHY_2M;

	shell_print(shell, "PHY set to: %s", phy_str(test_params.phy));

	return 0;
}

#if defined(RADIO_MODE_MODE_Ble_LR500Kbit) || defined(NRF5340_XXAA_APPLICATION)
int cmd_phy_coded_s2(const struct shell *shell, size_t argc,
			    char **argv)
{
	test_params.phy->options = BT_CONN_LE_PHY_OPT_CODED_S2;
	test_params.phy->pref_rx_phy = BT_GAP_LE_PHY_CODED;
	test_params.phy->pref_tx_phy = BT_GAP_LE_PHY_CODED;

	shell_print(shell, "PHY set to: %s", phy_str(test_params.phy));

	return 0;
}
#endif /* defined(RADIO_MODE_MODE_Ble_LR1500Kbit) ||
	* defined(NRF5340_XXAA_APPLICATION)
	*/

#if defined(RADIO_MODE_MODE_Ble_LR125Kbit) || defined(NRF5340_XXAA_APPLICATION)
int cmd_phy_coded_s8(const struct shell *shell, size_t argc,
			    char **argv)
{
	test_params.phy->options = BT_CONN_LE_PHY_OPT_CODED_S8;
	test_params.phy->pref_rx_phy = BT_GAP_LE_PHY_CODED;
	test_params.phy->pref_tx_phy = BT_GAP_LE_PHY_CODED;

	shell_print(shell, "PHY set to: %s",
		    phy_str(test_params.phy));

	return 0;
}
#endif /* defined(RADIO_MODE_MODE_Ble_LR125Kbit) ||
	* defined(NRF5340_XXAA_APPLICATION)
	*/

int data_len_cmd(const struct shell *shell, size_t argc,
			char **argv)
{
	uint16_t data_len;

	if (argc == 1) {
		shell_help(shell);
		return SHELL_CMD_HELP_PRINTED;
	}

	if (argc > 2) {
		shell_error(shell, "%s: bad parameters count", argv[0]);
		return -EINVAL;
	}

	data_len = strtol(argv[1], NULL, 10);

	if ((data_len < BT_GAP_DATA_LEN_DEFAULT) ||
	    (data_len > BT_GAP_DATA_LEN_MAX)) {
		shell_error(shell, "%s: Invalid setting: %d", argv[0],
			    data_len);
		shell_error(shell,
			    "LE Data Packet Length must be between: %d and %d",
			    BT_GAP_DATA_LEN_DEFAULT, BT_GAP_DATA_LEN_MAX);
		return -EINVAL;
	}

	test_params.data_len->tx_max_len = data_len;
	test_params.data_len->tx_max_time = BT_GAP_DATA_TIME_MAX;

	shell_print(shell, "LE Data Packet Length set to: %d", data_len);

	return 0;
}

int conn_interval_cmd(const struct shell *shell, size_t argc,
			     char **argv)
{
	uint16_t interval;

	if (argc == 1) {
		shell_help(shell);
		return SHELL_CMD_HELP_PRINTED;
	}

	if (argc > 2) {
		shell_error(shell, "%s: bad parameters count", argv[0]);
		return -EINVAL;
	}

	interval = strtol(argv[1], NULL, 10);

	if ((interval < MIN_CONN_INTERVAL) ||
	    (interval > MAX_CONN_INTERVAL)) {
		shell_error(shell, "%s: Invalid setting: %d", argv[0],
			    interval);
		shell_error(shell,
			    "Connection interval must be between: %d and %d",
			    MIN_CONN_INTERVAL, MAX_CONN_INTERVAL);
		return -EINVAL;
	}

	test_params.conn_param->interval_max = interval;
	test_params.conn_param->interval_min = interval;
	test_params.conn_param->latency = 0;
	test_params.conn_param->timeout = SUPERVISION_TIMEOUT;

	shell_print(shell, "Connection interval set to: %d",
		    interval);

	return 0;
}

int print_cmd(const struct shell *shell, size_t argc,
		     char **argv)
{
	shell_print(shell, "==== Current test configuration ====\n");
	shell_print(shell, "Data length:\t\t%d\n"
		    "Connection interval:\t%d units\n"
		    "Preferred PHY:\t\t%s\n",
		    test_params.data_len->tx_max_len,
		    test_params.conn_param->interval_min,
		    phy_str(test_params.phy));
	return 0;
}

SHELL_STATIC_SUBCMD_SET_CREATE(phy_sub,
	SHELL_CMD(1M, NULL, "Set preferred PHY to 1Mbps", cmd_phy_1m),
	SHELL_CMD(2M, NULL, "Set preferred PHY to 2Mbps", cmd_phy_2m),
#if defined(RADIO_MODE_MODE_Ble_LR500Kbit) || defined(NRF5340_XXAA_APPLICATION)
	SHELL_CMD(coded_s2, NULL, "Set preferred PHY to Coded S2",
		  cmd_phy_coded_s2),
#endif
#if defined(RADIO_MODE_MODE_Ble_LR125Kbit) || defined(NRF5340_XXAA_APPLICATION)
	SHELL_CMD(coded_s8, NULL, "Set preferred PHY to Coded S8",
		  cmd_phy_coded_s8),
#endif
	SHELL_SUBCMD_SET_END
);

SHELL_STATIC_SUBCMD_SET_CREATE(sub_config,
	SHELL_CMD(data_length, NULL, "Configure data length", data_len_cmd),
	SHELL_CMD(conn_interval, NULL,
		  "Configure connection interval <1.25ms units>",
		  conn_interval_cmd),
	SHELL_CMD(phy, &phy_sub, "Configure connection interval", default_cmd),
	SHELL_CMD(print, NULL, "Print current configuration", print_cmd),
	SHELL_SUBCMD_SET_END
);


int test_run_cmd(const struct shell *shell, size_t argc,
			char **argv)
{
	return test_run(shell, test_params.conn_param, test_params.phy,
			test_params.data_len);
}

int test_central_cmd(const struct shell *shell, size_t argc,
			    char **argv)
{
	select_role(true);
	return 0;
}

int test_peripheral_cmd(const struct shell *shell, size_t argc,
			       char **argv)
{
	select_role(false);
	return 0;
}


SHELL_CMD_REGISTER(config, &sub_config, "Configure the example", default_cmd);
SHELL_CMD_REGISTER(run, NULL, "Run the test", test_run_cmd);
SHELL_CMD_REGISTER(central, NULL, "Select central role", test_central_cmd);
SHELL_CMD_REGISTER(peripheral, NULL, "Select peripheral role", test_peripheral_cmd);

#endif
```

## src/bt_coex_test_functions.h
```c
/*
 * Copyright (c) 2022 Nordic Semiconductor ASA
 *
 * SPDX-License-Identifier: LicenseRef-Nordic-5-Clause
 */

#ifndef BT_COEX_TEST_FUNCTIONS_
#define BT_COEX_TEST_FUNCTIONS_

#include <stdio.h>
#include <stdlib.h>
#include <string.h>

#include "common.h"

#include <bluetooth/scan.h>

#include <zephyr/logging/log.h>
LOG_MODULE_REGISTER(bt_coex_test_func, CONFIG_LOG_DEFAULT_LEVEL);

#include <nrfx_clock.h>
#include <zephyr/kernel.h>
#include <zephyr/init.h>
#include <zephyr/device.h>
#include <zephyr/devicetree.h>
#include <zephyr/drivers/gpio.h>

#include <zephyr/shell/shell.h>
#include <zephyr/shell/shell_uart.h>

#include <zephyr/sys/byteorder.h>
#include <zephyr/net/zperf.h>
#include <zephyr/net/net_if.h>
#include <zephyr/net/wifi_mgmt.h>
#include <zephyr/net/net_event.h>
#include <zephyr/net/socket.h>

/* For net_sprint_ll_addr_buf */
#include "net_private.h"
#if !defined(BLE_PEER_THROUGHPUT_TEST) && !defined(BLE_PEER_CONN_CENTRAL_TEST)
#include <zephyr_coex.h>
#include <zephyr_coex_struct.h>
#endif

#include "bt_utils.h"
#if !defined(BLE_PEER_THROUGHPUT_TEST) && !defined(BLE_PEER_CONN_CENTRAL_TEST)
#include "zephyr_fmac_main.h"
#endif

#define MAX_SSID_LEN 32
#define WIFI_CONNECTION_TIMEOUT 30

#define PRINT_WIFI_SCAN_RESULT
#define PRINT_WIFI_CONN_RESULT
#define DEMARCATE_TEST_START

#define HIGHEST_CHANNUM_24G 14

extern bool ble_periph_connected;
uint8_t wait_for_ble_central_run;

static uint32_t wifi_scan_cnt_24g;
static uint32_t wifi_scan_cnt_5g;
static uint32_t wifi_scan_cmd_cnt;

static uint8_t wait_for_wifi_client_start;

extern uint32_t ble_conn_success_cnt;
extern uint32_t ble_conn_fail_cnt;

static uint32_t wifi_conn_success_cnt;
static uint32_t wifi_conn_fail_cnt;

static struct sockaddr_in in4_addr_my = {
	.sin_family = AF_INET,
	.sin_port = htons(CONFIG_NET_CONFIG_PEER_IPV4_PORT),
};

static uint32_t scan_result_count;
/**
 * @brief BT throughtput tets run 
 *
 * @return Zero on success or (negative) error code otherwise.
 */
void run_bt_benchmark(void);
/**
 * @brief commnad to start wifi scan
 *
 * @return Zero on success or (negative) error code otherwise.
 */
int cmd_wifi_scan(void);
/**
 * @brief Call wifi connection event
 *
 * @return Zero on success or (negative) error code otherwise.
 */
int wifi_connection(bool test_wlan, bool wifi_coex_enable,
				bool antenna_mode);
/**
 * @brief configure PTA registers
 *
 * @return Zero on success or (negative) error code otherwise.
 */
int config_pta(bool wifi_coex_enable, bool antenna_mode, bool ble_role,
				bool wlan_role);
/**
 * @brief Start wi-fi traffic for zperf udp upload or configure
 * zperf traffic for udp download
 *
 * @return Zero on success or (negative) error code otherwise.
 */
int run_wifi_traffic(bool test_wlan);
/**
 * @brief start BLE traffic using thread start
 *
 * @return Zero on success or (negative) error code otherwise.
 */
void start_ble_traffic(bool test_ble, bool ble_role);
/**
 * @brief check if iperf traffic is complete
 *
 * @return Zero on success or (negative) error code otherwise.
 */
void check_wifi_traffic(bool test_wlan);
/**
 * @brief run BLE traffic using thread join
 *
 * @return Zero on success or (negative) error code otherwise.
 */
void run_ble_traffic(bool test_ble, bool ble_role);
/**
 * @brief Disconnect Wi-Fi
 *
 * @return Zero on success or (negative) error code otherwise.
 */
void disconnect_wifi(bool test_wlan);
/**
 * @brief Disconnect BLE
 *
 * @return Zero on success or (negative) error code otherwise.
 */
void disconnect_ble(bool test_ble, bool ble_role);

static struct {
	uint8_t connected :1;
	uint8_t disconnect_requested: 1;
	uint8_t _unused : 6;
} context;

K_SEM_DEFINE(wait_for_next, 0, 1);
K_SEM_DEFINE(udp_callback, 0, 1);
struct wifi_iface_status status = { 0 };
uint32_t repeat_scan = 1;

#if !defined(BLE_PEER_THROUGHPUT_TEST) && !defined(BLE_PEER_CONN_CENTRAL_TEST)
K_THREAD_DEFINE(run_bt_traffic,
		CONFIG_WIFI_THREAD_STACK_SIZE,
		run_bt_benchmark,
		NULL,
		NULL,
		NULL,
		CONFIG_WIFI_THREAD_PRIORITY,
		0,
		K_TICKS_FOREVER);
#endif

/**
 * @brief Print Wi-Fi status
 *
 * @return Zero on success or (negative) error code otherwise.
 */
int cmd_wifi_status(void);
/**
 * @brief Initailise wifi arguments in variables
 *
 * @return Zero on success or (negative) error code otherwise.
 */
int __wifi_args_to_params(struct wifi_connect_req_params *params);
/**
 * @brief Request connection
 *
 * @return Zero on success or (negative) error code otherwise.
 */
int wifi_connect(void);
/**
 * @brief Request disconnection
 *
 * @return Zero on success or (negative) error code otherwise.
 */
int wifi_disconnect(void);
/**
 * @brief parse IPv4 address
 *
 * @return Zero on success or (negative) error code otherwise.
 */
int parse_ipv4_addr(char *host, struct sockaddr_in *addr);
/**
 * @brief wait for next wifi event
 *
 * @return Zero on success or (negative) error code otherwise.
 */
int wait_for_next_event(const char *event_name, int timeout);
/**
 * @brief CB for UDP download results
 *
 * @return Zero on success or (negative) error code otherwise.
 */
void udp_download_results_cb(enum zperf_status status,
			   struct zperf_results *result,
			   void *user_data);
/**
 * @brief CB for UDP upload results
 *
 * @return Zero on success or (negative) error code otherwise.
 */		   
void udp_upload_results_cb(enum zperf_status status,
			struct zperf_results *result,
			void *user_data);

#endif /* BT_COEX_TEST_FUNCTIONS_ */
```

## src/bt_utils.h
```c
/*
 * Copyright (c) 2022 Nordic Semiconductor ASA
 *
 * SPDX-License-Identifier: LicenseRef-Nordic-5-Clause
 */

#ifndef BT_UTILS_H_
#define BT_UTILS_H_

/**
 * Initialize BLE throughput test
 *
 * @return Zero on success or (negative) error code otherwise.
 */
int bt_throughput_test_init(bool ble_role);

/**
 * @brief Run BLE throughput test
 *
 * @return Zero on success or (negative) error code otherwise.
 */
int bt_throughput_test_run(void);

/**
 * @brief Exit BLE throughput test
 *
 * @return Zero on success or (negative) error code otherwise.
 */
int bt_throughput_test_exit(void);
/**
 * Initialize BLE scan --> connection test
 *
 * @return Zero on success or (negative) error code otherwise.
 */
int bt_connection_init(bool ble_role);

/**
 * @brief Initialization for BT connection
 *
 * @return Zero on success or (negative) error code otherwise.
 */
int bt_disconnect_central(void);

#endif /* BT_UTILS_H_ */
```

## src/main.h
```c
/*
 * Copyright (c) 2022 Nordic Semiconductor ASA
 *
 * SPDX-License-Identifier: LicenseRef-Nordic-5-Clause
 */

#ifndef MAIN_H_
#define MAIN_H_

#include "common.h"

#include <nrfx_clock.h>
#include <zephyr/kernel.h>
#include <zephyr/init.h>
#include <zephyr/device.h>
#include <zephyr/devicetree.h>
#include <zephyr/drivers/gpio.h>

#include <zephyr/shell/shell.h>
#include <zephyr/shell/shell_uart.h>

#include <zephyr/sys/byteorder.h>
#include <zephyr/net/zperf.h>
#include <zephyr/net/net_if.h>
#include <zephyr/net/wifi_mgmt.h>
#include <zephyr/net/net_event.h>
#include <zephyr/net/socket.h>
#if !defined(BLE_PEER_THROUGHPUT_TEST) && !defined(BLE_PEER_CONN_CENTRAL_TEST)
#include <zephyr_coex.h>
#endif

// #define WIFI_SCAN_BLE_CON_CENTRAL
// #define WIFI_SCAN_BLE_CON_PERIPH
// 
// #define WIFI_SCAN_BLE_TP_CENTRAL
// #define WIFI_SCAN_BLE_TP_PERIPH
// 
// #define WIFI_CON_BLE_CON_CENTRAL
// #define WIFI_CON_BLE_CON_PERIPH
// 
// #define WIFI_CON_BLE_TP_CENTRAL
// #define WIFI_CON_BLE_TP_PERIPH
// 
// #define WIFI_TP_CLIENT_BLE_CON_CENTRAL
//#define WIFI_TP_CLIENT_BLE_CON_PERIPH
 
#define WIFI_TP_CLIENT_BLE_TP_CENTRAL
// #define WIFI_TP_CLIENT_BLE_TP_PERIPH
// 
// #define WIFI_TP_SERVER_BLE_CON_CENTRAL
// #define WIFI_TP_SERVER_BLE_CON_PERIPH
// 
// #define WIFI_TP_SERVER_BLE_TP_CENTRAL
// #define WIFI_TP_SERVER_BLE_TP_PERIPH


/**
 *#define WIFI_SCAN_BLE_CON_CENTRAL
 *#define WIFI_SCAN_BLE_CON_PERIPH
 *
 *#define WIFI_SCAN_BLE_TP_CENTRAL
 *#define WIFI_SCAN_BLE_TP_PERIPH
 *
 *#define WIFI_CON_BLE_CON_CENTRAL
 *#define WIFI_CON_BLE_CON_PERIPH
 *
 *#define WIFI_CON_BLE_TP_CENTRAL
 *#define WIFI_CON_BLE_TP_PERIPH
 *
 *#define WIFI_TP_CLIENT_BLE_CON_CENTRAL
 *#define WIFI_TP_CLIENT_BLE_CON_PERIPH
 *
 *#define WIFI_TP_CLIENT_BLE_TP_CENTRAL
 *#define WIFI_TP_CLIENT_BLE_TP_PERIPH
 *
 *#define WIFI_TP_SERVER_BLE_CON_CENTRAL
 *#define WIFI_TP_SERVER_BLE_CON_PERIPH
 *
 *#define WIFI_TP_SERVER_BLE_TP_CENTRAL
 *#define WIFI_TP_SERVER_BLE_TP_PERIPH
 */
#define WIFI_MGMT_EVENTS (NET_EVENT_WIFI_CONNECT_RESULT | \
				NET_EVENT_WIFI_DISCONNECT_RESULT)

static struct net_mgmt_event_callback wifi_sta_mgmt_cb;
static struct net_mgmt_event_callback net_addr_mgmt_cb;
/**
 * @brief Print Test Params Info
 *
 * @return No return value.
 */
void print_test_params_info(bool test_wlan, bool test_ble, bool antenna_mode,
		bool ble_role,
		bool wifi_coex_enable, bool ble_coex_enable, bool coex_hardware_enable);
/**
 * @brief Funtion to test Wi-Fi scan and BLE connection central
 *
 * @return Zero on success or (negative) error code otherwise.
 */
int wifi_scan_ble_conn_central(bool wifi_coex_enable, bool antenna_mode, bool test_ble,
		bool test_wlan, bool ble_role, bool wlan_role, bool coex_hardware_enable);
/**
 * @brief Funtion to test Wi-Fi scan and BLE connection peripheral
 *
 * @return Zero on success or (negative) error code otherwise.
 */
int wifi_scan_ble_conn_peripheral(bool wifi_coex_enable, bool antenna_mode,
		bool test_ble, bool test_wlan, bool ble_role, bool wlan_role,
		bool coex_hardware_enable);
/**
 * @brief Funtion to test Wi-Fi scan and BLE throughput central
 *
 * @return Zero on success or (negative) error code otherwise.
 */
int wifi_scan_ble_tput_central(bool wifi_coex_enable, bool antenna_mode, bool test_ble,
		bool test_wlan, bool ble_role, bool wlan_role, bool coex_hardware_enable);
/**
 * @brief Funtion to test Wi-Fi scan and BLE throughput peripheral
 *
 * @return Zero on success or (negative) error code otherwise.
 */
int wifi_scan_ble_tput_peripheral(bool wifi_coex_enable, bool antenna_mode,
		bool test_ble, bool test_wlan, bool ble_role, bool wlan_role,
		bool coex_hardware_enable);
/**
 * @brief Funtion to test Wi-Fi connection and BLE connection central
 *
 * @return Zero on success or (negative) error code otherwise.
 */
int wifi_con_ble_con_central(bool test_wlan, bool wifi_coex_enable, bool test_ble,
		bool ble_role, bool wlan_role, bool antenna_mode, bool coex_hardware_enable);
/**
 * @brief Funtion to test Wi-Fi connection and BLE connection peripheral
 *
 * @return Zero on success or (negative) error code otherwise.
 */
int wifi_con_ble_con_peripheral(bool test_wlan, bool wifi_coex_enable, bool test_ble,
		bool ble_role, bool wlan_role, bool antenna_mode, bool coex_hardware_enable);
/**
 * @brief Funtion to test Wi-Fi connection and BLE throughput central
 *
 * @return Zero on success or (negative) error code otherwise.
 */
int wifi_con_ble_tput_central(bool test_wlan, bool wifi_coex_enable, bool antenna_mode,
		bool test_ble, bool ble_role, bool wlan_role, bool coex_hardware_enable);
/**
 * @brief Funtion to test Wi-Fi connection and BLE throughput peripheral
 *
 * @return Zero on success or (negative) error code otherwise.
 */
int wifi_con_ble_tput_peripheral(bool test_wlan, bool wifi_coex_enable,
		bool antenna_mode, bool test_ble, bool ble_role, bool wlan_role,
		bool coex_hardware_enable);
/**
 * @brief Funtion to test Wi-Fi throughput and BLE connection central
 *
 * @return Zero on success or (negative) error code otherwise.
 */
int wifi_tput_client_ble_con_central(bool test_wlan, bool wifi_coex_enable,
		bool test_ble, bool ble_role, bool wlan_role, bool antenna_mode,
		bool coex_hardware_enable);
/**
 * @brief Funtion to test Wi-Fi throughput client and BLE 
 * connection peripheral
 *
 * @return Zero on success or (negative) error code otherwise.
 */
int wifi_tput_client_ble_con_peripheral(bool test_wlan, bool wifi_coex_enable,
		bool test_ble, bool ble_role, bool wlan_role, bool antenna_mode,
		bool coex_hardware_enable);
/**
 * @brief Funtion to test Wi-Fi throughput client and BLE 
 * throughput central
 *
 * @return Zero on success or (negative) error code otherwise.
 */
int wifi_tput_client_ble_tput_central(bool test_wlan, bool wifi_coex_enable,
		bool antenna_mode, bool test_ble, bool ble_role, bool wlan_role,
		bool coex_hardware_enable);
/**
 * @brief Funtion to test Wi-Fi throughput client and BLE 
 * throughput peripheral
 *
 * @return Zero on success or (negative) error code otherwise.
 */
int wifi_tput_client_ble_tput_peripheral(bool test_wlan, bool wifi_coex_enable,
		bool antenna_mode, bool test_ble, bool ble_role, bool wlan_role,
		bool coex_hardware_enable);
/**
 * @brief Funtion to test Wi-Fi throughput server and BLE 
 * connection central
 *
 * @return Zero on success or (negative) error code otherwise.
 */
int wifi_tput_server_ble_con_central(bool test_wlan, bool wifi_coex_enable,
		bool test_ble, bool ble_role, bool wlan_role, bool antenna_mode,
		bool coex_hardware_enable);
/**
 * @brief Funtion to test Wi-Fi throughput server and BLE 
 * connection peripheral
 *
 * @return Zero on success or (negative) error code otherwise.
 */
int wifi_tput_server_ble_con_peripheral(bool test_wlan, bool wifi_coex_enable,
		bool test_ble, bool ble_role, bool wlan_role, bool antenna_mode,
		bool coex_hardware_enable);
/**
 * @brief Funtion to test Wi-Fi throughput server and BLE 
 * throughput central
 *
 * @return Zero on success or (negative) error code otherwise.
 */
int wifi_tput_server_ble_tput_central(bool test_wlan, bool wifi_coex_enable,
		bool antenna_mode, bool test_ble, bool ble_role, bool wlan_role,
		bool coex_hardware_enable);
/**
 * @brief Funtion to test Wi-Fi throughput server and BLE 
 * throughput peripheral
 *
 * @return Zero on success or (negative) error code otherwise.
 */
int wifi_tput_server_ble_tput_peripheral(bool test_wlan, bool wifi_coex_enable,
		bool antenna_mode, bool test_ble, bool ble_role, bool wlan_role,
		bool coex_hardware_enable);
/**
 * @brief memset_context
 *
 * @return No return value.
 */
void memset_context(void);
/**
 * @brief CB for Wi-Fi connection result
 *
 * @return No return value.
 */
void handle_wifi_connect_result(struct net_mgmt_event_callback *cb);
/**
 * @brief CB for Wi-Fi disconnection result
 *
 * @return No return value.
 */
void handle_wifi_disconnect_result(struct net_mgmt_event_callback *cb);
/**
 * @brief CB for Wi-Fi scan result
 *
 * @return No return value.
 */
void handle_wifi_scan_result(struct net_mgmt_event_callback *cb);
/**
 * @brief CB for Wi-Fi scan done
 *
 * @return No return value.
 */
void handle_wifi_scan_done(struct net_mgmt_event_callback *cb);
/**
 * @brief print DHCP IP addredd assigned
 *
 * @return No return value.
 */
void print_dhcp_ip(struct net_mgmt_event_callback *cb);
/**
 * @brief Handle net management events
 *
 * @return No return value.
 */
void net_mgmt_event_handler(struct net_mgmt_event_callback *cb,
				    uint32_t mgmt_event, struct net_if *iface);
/**
 * @brief Handle Wi-Fi management events
 *
 * @return No return value.
 */
void wifi_mgmt_event_handler(struct net_mgmt_event_callback *cb,
				uint32_t mgmt_event, struct net_if *iface);					

#endif /* MAIN_H_ */
```
